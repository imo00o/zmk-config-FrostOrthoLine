## Kconfig
```kconfig
config FROSTORTHOLINE_PAT9125
    bool "PAT9125 X/Y input driver (level-triggered MOTION)"
    default y
    depends on DT_HAS_PIXART_PAT9125_ZMK_ENABLED
    depends on INPUT
    select I2C
    select GPIO
    help
      PAT9125EL を X/Y の相対移動入力として使うドライバ。
      MOTION をレベル割り込みで検出し、MOTION が出ている間は一定間隔で読み続ける。
```

## boards/shields/FrostOrthoLine/Kconfig.defconfig
```kconfig
if SHIELD_FROSTORTHOLINE

config ZMK_KEYBOARD_NAME
    default "FrostOrthoLine"

config ZMK_POINTING
    default y

endif
```

## boards/shields/FrostOrthoLine/Kconfig.shield
```kconfig
config SHIELD_FROSTORTHOLINE
    def_bool $(shields_list_contains,FrostOrthoLine)
```

## config/boards/shields/FrostOrthoLine/Kconfig.defconfig
```kconfig
if SHIELD_FROSTORTHOLINE

config ZMK_KEYBOARD_NAME
    default "FrostOrthoLine"

config ZMK_POINTING     # paw3222
    default y

config PAW3222      # paw3222
    default y

endif
```

## config/west.yml
```yaml
manifest:
  remotes:
    - name: zmkfirmware
      url-base: https://github.com/zmkfirmware
    - name: cormoran
      url-base: https://github.com/cormoran
    - name: sekigon-gonnoc  # hires-dial
      url-base: https://github.com/sekigon-gonnoc
    - name: kot149  # マウスジェスチャー
      url-base: https://github.com/kot149
  projects:
    # ZMK main (Zephyr 4.1) + DYA Studio 対応の cormoran 版
    - name: zmk
      remote: cormoran
      revision: main+dya
      import: app/west.yml
    - name: zmk-driver-hires-dial
      remote: sekigon-gonnoc
      revision: master
    - name: zmk-mouse-gesture
      remote: kot149
      revision: v2
    # DYA Studio モジュール
    - name: zmk-module-ble-management
      remote: cormoran
      revision: main
    - name: zmk-module-settings-rpc
      remote: cormoran
      revision: main
    - name: zmk-module-runtime-input-processor
      remote: cormoran
      revision: main
    - name: zmk-feature-custom-settings
      remote: cormoran
      revision: main
    - name: zmk-feature-runtime-combo
      remote: cormoran
      revision: main
  self:
    path: config
```

## dts/bindings/input/pixart,pat9125-zmk.yaml
```yaml
# PAT9125EL を X/Y の相対移動（カーソル）として使う入力ドライバ
#
# Zephyr 標準の pixart,pat912x と同じレジスタ操作だが、次の点を変えている
#   - 初期化時にソフトウェアリセットをしない
#   - MOTION をエッジではなくレベル割り込みで検出し、MOTION が出ている間は
#     一定間隔で読み続ける（エッジの取りこぼしで止まらないようにする）
# 割り込みとリセットの扱いは zmk-driver-hires-dial に合わせている

description: PAT9125EL optical navigation chip as a relative X/Y input device

compatible: "pixart,pat9125-zmk"

include: i2c-device.yaml

properties:
  motion-gpios:
    type: phandle-array
    required: true
    description: GPIO connected to the active-low MOTION output.

  res-x-cpi:
    type: int
    default: 1275
    description: X resolution in CPI (0-1275, 5 CPI steps).

  res-y-cpi:
    type: int
    default: 1275
    description: Y resolution in CPI (0-1275, 5 CPI steps).

  invert-x:
    type: boolean
    description: Invert X axis.

  invert-y:
    type: boolean
    description: Invert Y axis.

  swap-xy:
    type: boolean
    description: Swap X and Y axes (applied before inversion).

  motion-read-interval-ms:
    type: int
    default: 8
    description: Delay between reads while MOTION stays asserted.

  sleep1-enable:
    type: boolean
    description: Enable sensor sleep1 mode.

  sleep2-enable:
    type: boolean
    description: Enable sensor sleep2 mode (requires sleep1-enable).
```
